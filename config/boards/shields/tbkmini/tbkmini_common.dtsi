/*
 * Copyright (c) 2021 Casey Webster
 *
 * SPDX-License-Identifier: MIT
 */

#include <dt-bindings/zmk/matrix_transform.h>

/ {
	chosen {
		zmk,kscan = &kscan0;
		zmk,matrix_transform = &default_transform;
	};

	kscan: kscan {
        	compatible = "zmk,kscan-gpio-matrix";
        	diode-direction = "col2row";
        	wakeup-source;
	};

	// TODO: RGB node(s)
};
